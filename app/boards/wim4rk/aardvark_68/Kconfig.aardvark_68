## app/boards/wim4rk/aardvark_68/Kconfig.aardvark_68
```kconfig
# Aardvark 68 board configuration

# Copyright (c) 2026 The ZMK Contributors
# SPDX-License-Identifier: MIT

config BOARD_AARDVARK_68
	select SOC_STM32WB55XX
	imply RETAINED_MEM
	imply RETENTION
	imply RETENTION_BOOT_MODE
	imply STM32_BOOTLOADER
	imply RTC
	imply BBRAM
```

## app/boards/wim4rk/aardvark_68/board.yml
```yaml
boards:
  - name: aardvark_68
    vendor: wim4rk
    socs:
      - name: stm32wb55xx
        variants:
          - name: zmk
    revision:
      format: major.minor.patch
      default: 1.0.0
      revisions:
        - name: 1.0.0
```
